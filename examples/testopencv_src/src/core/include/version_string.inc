"\n"
"General configuration for OpenCV 3.0.0-beta =====================================\n"
"  Version control:               unknown\n"
"\n"
"  Platform:\n"
"    Host:                        Linux 3.13.0-43-generic x86_64\n"
"    CMake:                       2.8.12.2\n"
"    CMake generator:             Unix Makefiles\n"
"    CMake build tool:            /usr/bin/make\n"
"    Configuration:               Release\n"
"\n"
"  C/C++:\n"
"    Built as dynamic libs?:      NO\n"
"    C++ Compiler:                /usr/bin/c++  (ver 4.8.2)\n"
"    C++ flags (Release):         -fPIC   -fsigned-char -W -Wall -Werror=return-type -Werror=non-virtual-dtor -Werror=address -Werror=sequence-point -Wformat -Werror=format-security -Wmissing-declarations -Wundef -Winit-self -Wpointer-arith -Wshadow -Wsign-promo -Wno-narrowing -Wno-delete-non-virtual-dtor -fdiagnostics-show-option -Wno-long-long -pthread -fno-omit-frame-pointer -ffunction-sections -fvisibility=hidden -fvisibility-inlines-hidden -O3 -DNDEBUG  -DNDEBUG\n"
"    C++ flags (Debug):           -fPIC   -fsigned-char -W -Wall -Werror=return-type -Werror=non-virtual-dtor -Werror=address -Werror=sequence-point -Wformat -Werror=format-security -Wmissing-declarations -Wundef -Winit-self -Wpointer-arith -Wshadow -Wsign-promo -Wno-narrowing -Wno-delete-non-virtual-dtor -fdiagnostics-show-option -Wno-long-long -pthread -fno-omit-frame-pointer -ffunction-sections -fvisibility=hidden -fvisibility-inlines-hidden -g  -O0 -DDEBUG -D_DEBUG\n"
"    C Compiler:                  /usr/bin/cc\n"
"    C flags (Release):           -fPIC   -fsigned-char -W -Wall -Werror=return-type -Werror=non-virtual-dtor -Werror=address -Werror=sequence-point -Wformat -Werror=format-security -Wmissing-declarations -Wmissing-prototypes -Wstrict-prototypes -Wundef -Winit-self -Wpointer-arith -Wshadow -Wno-narrowing -fdiagnostics-show-option -Wno-long-long -pthread -fno-omit-frame-pointer -ffunction-sections -fvisibility=hidden -O3 -DNDEBUG  -DNDEBUG\n"
"    C flags (Debug):             -fPIC   -fsigned-char -W -Wall -Werror=return-type -Werror=non-virtual-dtor -Werror=address -Werror=sequence-point -Wformat -Werror=format-security -Wmissing-declarations -Wmissing-prototypes -Wstrict-prototypes -Wundef -Winit-self -Wpointer-arith -Wshadow -Wno-narrowing -fdiagnostics-show-option -Wno-long-long -pthread -fno-omit-frame-pointer -ffunction-sections -fvisibility=hidden -g  -O0 -DDEBUG -D_DEBUG\n"
"    Linker flags (Release):      \n"
"    Linker flags (Debug):        \n"
"    Precompiled headers:         NO\n"
"\n"
"  OpenCV modules:\n"
"    To be built:                 core\n"
"    Disabled:                    calib3d features2d flann highgui imgcodecs imgproc ml objdetect photo shape stitching superres ts video videoio videostab world\n"
"    Disabled by dependency:      -\n"
"    Unavailable:                 androidcamera cuda cudaarithm cudabgsegm cudacodec cudafeatures2d cudafilters cudaimgproc cudalegacy cudaoptflow cudastereo cudawarping cudev java python2 python3 viz\n"
"\n"
"  GUI: \n"
"    QT:                          NO\n"
"    GTK+:                        NO\n"
"    GThread :                    NO\n"
"    GtkGlExt:                    NO\n"
"    OpenGL support:              NO\n"
"    VTK support:                 NO\n"
"\n"
"  Media I/O: \n"
"    ZLib:                        zlib (ver 1.2.8)\n"
"    JPEG:                        NO\n"
"    WEBP:                        NO\n"
"    PNG:                         NO\n"
"    TIFF:                        NO\n"
"    JPEG 2000:                   NO\n"
"    OpenEXR:                     NO\n"
"    GDAL:                        NO\n"
"\n"
"  Video I/O:\n"
"    DC1394 1.x:                  NO\n"
"    DC1394 2.x:                  NO\n"
"    FFMPEG:                      NO\n"
"      codec:                     NO\n"
"      format:                    NO\n"
"      util:                      NO\n"
"      swscale:                   NO\n"
"      gentoo-style:              NO\n"
"    GStreamer:                   NO\n"
"    OpenNI:                      NO\n"
"    OpenNI PrimeSensor Modules:  NO\n"
"    OpenNI2:                     NO\n"
"    PvAPI:                       NO\n"
"    GigEVisionSDK:               NO\n"
"    UniCap:                      NO\n"
"    UniCap ucil:                 NO\n"
"    V4L/V4L2:                    NO/NO\n"
"    XIMEA:                       NO\n"
"    Xine:                        NO\n"
"\n"
"  Other third-party libraries:\n"
"    Use IPP:                     NO\n"
"    Use IPP Async:               NO\n"
"    Use Eigen:                   NO\n"
"    Use TBB:                     NO\n"
"    Use OpenMP:                  NO\n"
"    Use GCD                      NO\n"
"    Use Concurrency              NO\n"
"    Use C=:                      NO\n"
"    Use Cuda:                    NO\n"
"    Use OpenCL:                  NO\n"
"\n"
"  Python 2:\n"
"    Interpreter:                 /usr/bin/python2.7 (ver 2.7.6)\n"
"\n"
"  Python 3:\n"
"    Interpreter:                 /usr/bin/python3.4 (ver 3.4)\n"
"\n"
"  Python (for build):            /usr/bin/python2.7\n"
"\n"
"  Java:\n"
"    ant:                         /usr/bin/ant (ver 1.9.3)\n"
"    JNI:                         NO\n"
"    Java wrappers:               NO\n"
"    Java tests:                  NO\n"
"\n"
"  Matlab:\n"
"    mex:                         NO\n"
"\n"
"  Tests and samples:\n"
"    Tests:                       NO\n"
"    Performance tests:           NO\n"
"    C/C++ Examples:              NO\n"
"\n"
"  Install path:                  /usr/local\n"
"\n"
"  cvconfig.h is in:              /home/so/workspace_kepler/opencv-3.0.0-beta/build\n"
"-----------------------------------------------------------------\n"
"\n"
